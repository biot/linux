## Documentation/devicetree/bindings/interrupt-controller/realtek,rtl8380-intc.yaml
```yaml
# SPDX-License-Identifier: (GPL-2.0-only OR BSD-2-Clause)
%YAML 1.2
---
$id: http://devicetree.org/schemas/interrupt-controller/realtek,rtl8380-intc.yaml#
$schema: http://devicetree.org/meta-schemas/core.yaml#

title: Realtek RTL8380 SoC interrupt controller devicetree bindings

maintainers:
  - Birger Koblitz <mail@birger-koblitz.de>
  - Bert Vermeulen <bert@biot.com>
  - John Crispin <john@phrozen.org>

properties:
  compatible:
    const: realtek,rtl8380-intc

  "#interrupt-cells":
    const: 1

  reg:
    maxItems: 1

  interrupts:
    maxItems: 1

  interrupt-controller: true

required:
  - compatible
  - reg
  - "#interrupt-cells"
  - interrupt-controller

additionalProperties: false

examples:
  - |
    intc: interrupt-controller@3000 {
      compatible = "realtek,rtl8380-intc";
      #interrupt-cells = <1>;
      interrupt-controller;
      reg = <0x3000 0x20>;
    }
```

## Documentation/devicetree/bindings/soc/realtek/realtek-chipid.yaml
```yaml
# SPDX-License-Identifier: GPL-2.0-or-later
%YAML 1.2
---
$id: http://devicetree.org/schemas/soc/realtek/realtek-chipid.yaml#
$schema: http://devicetree.org/meta-schemas/core.yaml#

title: Realtek switch SoC platform identification driver

maintainers:
  - Sander Vanheule <sander@svanheule.net>
  - Bert Vermeulen <bert@biot.com>

description: |
  Realtek chipid driver uses the model name and chip revision registers to
  identify the SoC. Since the relevant registers have evolved over different
  SoC generations, a family may require access to more registers than others.
  For all families, the (first) range specified by `reg` points to the chip
  info registers.
  For RTL838x, all chip info registers can only be read succesfully if they
  can be unlocked. To this end, the register unlock register should be provided
  as a second item in `reg`. Finally, to correctly identify all RTL8380-class
  models, the 'MODE_DEFINE_CTL' register should be defined as a third item.

properties:
  $nodename:
    pattern: "^chipid@[0-9a-f]+$"

  compatible:
    enum:
      - realtek,rtl8380-chipid
      - realtek,rtl8390-chipid
      - realtek,rtl9300-chipid
      - reatlek,rtl9310-chipid

  reg:
    description:
      List of register ranges used to identify the SoC

allOf:
  - if:
      properties:
        compatible:
          contains:
            const: realtek,rtl8380-chipid
    then:
      properties:
        reg:
          minItems: 3
          maxItems: 3
    else:
      properties:
        reg:
          minItems: 1
          maxItems: 1

required:
  - compatible
  - reg

additionalProperties: false

examples:
  - |
    chipid@d0 {
        compatible = "realtek,rtl8380-chipid";
        /* Specify chip info, register unlock, feature definition */
        reg = <0x00d0 0x10>, <0x0058 0x4>, <0x1024 0x4>;
    };
  - |
    chipid@0 {
        compatible = "realtek,rtl9300-chipid";
        /* Only specify chip info range */
        reg = <0x0000 0x8>;
    };
```

## Documentation/devicetree/bindings/spi/realtek,rtl-spi.yaml
```yaml
# SPDX-License-Identifier: (GPL-2.0-only OR BSD-2-Clause)
%YAML 1.2
---
$id: http://devicetree.org/schemas/spi/realtek,rtl-spi.yaml#
$schema: http://devicetree.org/meta-schemas/core.yaml#

title: Realtek RTL838x/RTL839x SPI controller

maintainers:
  - Bert Vermeulen <bert@biot.com>
  - Birger Koblitz <mail@birger-koblitz.de>

allOf:
  - $ref: "spi-controller.yaml#"

properties:
  compatible:
    const: realtek,rtl-spi

  reg:
    maxItems: 1

required:
  - compatible
  - reg

unevaluatedProperties: false

examples:
  - |
    spi: spi@1200 {
        compatible = "realtek,rtl-spi";
        reg = <0x1200 0x100>;
        #address-cells = <1>;
        #size-cells = <0>;
    };
```

## drivers/soc/realtek/Kconfig
```kconfig
# SPDX-License-Identifier: GPL-2.0-or-later

if MACH_REALTEK_RTL

config REALTEK_RTL_CHIPID
	bool "Realtek switch SoC chip ID"
	default MACH_REALTEK_RTL
	select MFD_SYSCON
	select REGMAP
	select SOC_BUS
	help
	  Support Realtek switch SoC identification

endif
```
