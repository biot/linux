// SPDX-License-Identifier: GPL-2.0-or-later OR BSD-2-Clause

&soc {
	spi: spi@1200 {
		compatible = "realtek,rtl8393-spi";
		reg = <0x1200 0x100>;

		#address-cells = <1>;
		#size-cells = <0>;

		status = "disabled";
	};
};
