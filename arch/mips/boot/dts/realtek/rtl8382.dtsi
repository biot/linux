// SPDX-License-Identifier: GPL-2.0-or-later OR BSD-2-Clause

&soc {
	spi: spi@1200 {
		compatible = "realtek,rtl8382-spi";
		reg = <0x1200 0x100>;

		#address-cells = <1>;
		#size-cells = <0>;

		status = "disabled";
	};
};

&switch_bus {
	ethernet0: ethernet@0 {
		status = "okay";
		compatible = "realtek,rtl8382-eth";
		reg = <0x0 0x10000>;
		interrupt-parent = <&intc>;
		interrupts = <24>;
		interrupt-cells = <1>;
		phy-mode = "internal";
		fixed-link {
			speed = <1000>;
			full-duplex;
		};
	};
	mdio-bus {
		compatible = "realtek,rtl8382-mdio";
		#address-cells = <1>;
		#size-cells = <0>;

		EXTERNAL_PHY(8)
		EXTERNAL_PHY(9)
		EXTERNAL_PHY(10)
		EXTERNAL_PHY(11)
		EXTERNAL_PHY(12)
		EXTERNAL_PHY(13)
		EXTERNAL_PHY(14)
		EXTERNAL_PHY(15)
	};
};
